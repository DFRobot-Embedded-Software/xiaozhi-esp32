## main/boards/df-p4_ai_interaction_development_board/sdkconfig.defaults
```kconfig
# DFRobot FireBeetle 2 ESP32-P4 AI Interaction Development Board (ESP32-P4 v3.x)
# 手动编译时与项目默认配置合并使用，例如：
#   idf.py -DSDKCONFIG_DEFAULTS="main/boards/df-p4_ai_interaction_development_board/sdkconfig.defaults;sdkconfig.defaults;sdkconfig.defaults.esp32p4" set-target esp32p4

CONFIG_SLAVE_IDF_TARGET_ESP32C6=y
CONFIG_ESP_HOSTED_SDIO_HOST_INTERFACE=y
CONFIG_ESP_HOSTED_SDIO_4_BIT_BUS=y
CONFIG_ESP_HOSTED_PRIV_SDIO_PIN_CLK_SLOT_1=18
CONFIG_ESP_HOSTED_PRIV_SDIO_PIN_CMD_SLOT_1=19
CONFIG_ESP_HOSTED_PRIV_SDIO_PIN_D0_SLOT_1=14
CONFIG_ESP_HOSTED_PRIV_SDIO_PIN_D1_4BIT_BUS_SLOT_1=15
CONFIG_ESP_HOSTED_PRIV_SDIO_PIN_D2_4BIT_BUS_SLOT_1=16
CONFIG_ESP_HOSTED_PRIV_SDIO_PIN_D3_4BIT_BUS_SLOT_1=17
CONFIG_ESP_HOSTED_SDIO_GPIO_RESET_SLAVE=5

# ESP32-P4 v3.x（本板为 v3.2，勿使用 v1.x 配置）
# CONFIG_ESP32P4_SELECTS_REV_LESS_V3 is not set
CONFIG_ESP32P4_REV_MIN_301=y
```
